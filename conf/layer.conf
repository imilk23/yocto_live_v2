## conf/layer.conf
```bitbake
# We have a conf and classes directory, add to BBPATH
BBPATH .= ":${LAYERDIR}"

# We have recipes-* directories, add to BBFILES
BBFILES += "${LAYERDIR}/recipes-*/*/*.bb \
            ${LAYERDIR}/recipes-*/*/*.bbappend"

BBFILE_COLLECTIONS += "meta-live"
BBFILE_PATTERN_meta-live = "^${LAYERDIR}/"
BBFILE_PRIORITY_meta-live = "6"

LAYERDEPENDS_meta-live = "core"
LAYERSERIES_COMPAT_meta-live = "dunfell"
```

## meta-live/conf/distro/livedistro.conf
```bitbake
require conf/distro/poky.conf

DISTRO = "livedistro"
DISTRO_NAME = "livedistro (Yocto Live Coding Reference Distro)"
DISTRO_VERSION = "1.0.0"
DISTRO_CODENAME = "warrior"

DISTRO_FEATURES_append = " systemd pam"
VIRTUAL-RUNTIME_init_manager = "systemd"
 
DISTRO_FEATURES_BACKFILL_CONSIDERED = "sysvinit"

VIRTUAL-RUNTIME_initscripts = ""

#PREFERRED_PROVIDER_virtual/libc = "musl"
#PREFERRED_PROVIDER_virtual/libiconv = "musl"
```

## meta-praseodymium/conf/layer.conf
```bitbake
# We have a conf and classes directory, add to BBPATH
BBPATH .= ":${LAYERDIR}"

# We have recipes-* directories, add to BBFILES
BBFILES += "${LAYERDIR}/recipes-*/*/*.bb \
            ${LAYERDIR}/recipes-*/*/*.bbappend"

BBFILE_COLLECTIONS += "meta-praseodymium"
BBFILE_PATTERN_meta-praseodymium = "^${LAYERDIR}/"
BBFILE_PRIORITY_meta-praseodymium = "6"

LAYERDEPENDS_meta-praseodymium = "core"
LAYERSERIES_COMPAT_meta-praseodymium = "dunfell"
```

## meta-quicksilver/conf/distro/quicksilver-systemd.conf
```bitbake
require conf/distro/poky.conf

DISTRO = "quicksilver-systemd"
DISTRO_NAME = "quicksilver-systemd (Poky - Yocto Project Reference Distro - based demonstration distro)"
DISTRO_VERSION = "1.0.0"
DISTRO_CODENAME = "dunfell"

# Override these in poky based distros
POKY_DEFAULT_DISTRO_FEATURES = ""
POKY_DEFAULT_EXTRA_RDEPENDS = "packagegroup-core-boot"
POKY_DEFAULT_EXTRA_RRECOMMENDS = ""

DISTRO_FEATURES_append = " systemd"
VIRTUAL-RUNTIME_init_manager = "systemd"
DISTRO_FEATURES_BACKFILL_CONSIDERED = "sysvinit"
VIRTUAL-RUNTIME_initscripts = ""
```

## meta-quicksilver/conf/layer.conf
```bitbake
# We have a conf and classes directory, add to BBPATH
BBPATH .= ":${LAYERDIR}"

# We have recipes-* directories, add to BBFILES
BBFILES += "${LAYERDIR}/recipes-*/*/*.bb \
            ${LAYERDIR}/recipes-*/*/*.bbappend"

BBFILE_COLLECTIONS += "meta-quicksilver"
BBFILE_PATTERN_meta-quicksilver = "^${LAYERDIR}/"
BBFILE_PRIORITY_meta-quicksilver = "6"

LAYERDEPENDS_meta-quicksilver = "core"
LAYERSERIES_COMPAT_meta-quicksilver = "dunfell"
```
